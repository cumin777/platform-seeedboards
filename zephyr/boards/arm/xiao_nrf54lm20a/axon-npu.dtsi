/*
 * Copyright (c) 2026 Seeed Technology Co., Ltd.
 *
 * SPDX-License-Identifier: Apache-2.0
 *
 * Axon NPU node definition for nRF54LM20B chip mounted on a XIAO nRF54LM20A
 * carrier board (the "20b test board").
 *
 * Register values mirror the upstream NCS definition found in
 * dts/vendor/nordic/nrf54lm20b.dtsi:
 *   &global_peripherals {
 *       axon: axon@56000 {
 *           compatible = "nordic,axon";
 *           reg = <0x56000 0x1000>;
 *           interrupts = <86 NRF_DEFAULT_IRQ_PRIORITY>;
 *           status = "disabled";
 *       };
 *   };
 *
 * The node is attached to &global_peripherals (inside the soc simple-bus)
 * so that it inherits the interrupt-parent (cpuapp_nvic) from the parent
 * soc node.
 */

&global_peripherals {
	axon: axon@56000 {
		compatible = "nordic,axon";
		reg = <0x56000 0x1000>;
		interrupts = <86 NRF_DEFAULT_IRQ_PRIORITY>;
		status = "okay";
	};
};
