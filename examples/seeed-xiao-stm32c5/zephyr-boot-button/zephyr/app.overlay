/* Keep the sample self-contained; the board DTS also exposes this as sw0. */
#include <zephyr/dt-bindings/gpio/gpio.h>
#include <zephyr/dt-bindings/input/input-event-codes.h>

/ {
	buttons {
		compatible = "gpio-keys";

		boot_button_sample: button_0 {
			gpios = <&gpioh 2 (GPIO_PULL_UP | GPIO_ACTIVE_LOW)>;
			label = "BOOT button";
			zephyr,code = <INPUT_KEY_0>;
		};
	};

	aliases {
		sw0 = &boot_button_sample;
	};
};
